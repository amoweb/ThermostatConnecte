## ESP32/sdkconfig.defaults
```kconfig
CONFIG_PARTITION_TABLE_CUSTOM=y
CONFIG_PARTITION_TABLE_CUSTOM_FILENAME="partitions_table.csv"
CONFIG_PARTITION_TABLE_FILENAME="partitions_table.csv"
```

## ESP32_hw2/Composants/LED_RGB/Kconfig.projbuild
```kconfig
	menu "Configuration LED RGB"
    depends on LED_RGB
    
    config GAMMA_CORRECTION_WITH_LUT
        bool "Use look up table to do gamma correction"
        default n
        help
            Par défaut, la correction gamma est réalisée par le biais de l'opération de puissance mathématique.
            Cela nécessite un calcul par le système. Avec cette option activée, la correction gamma sera basée 
            sur une table de recherche. Notez que le tableau de recherche fourni ne concerne que un facteur gamma de 2,6.


	endmenu
```

## ESP32_hw2/Composants/SERVEUR_FICHIER/Kconfig.projbuild
```kconfig
menu "Configuration serveur de fichiers http"

    config DOSSIER_DE_BASE
        string "Nom du dossier de base du serveur de fichier"
        default "fichier"
        help
            Racine du serveur de fichier.
            
    config HTTPD_CONN_CLOSE_HEADER
        bool "Envoyer un en-tête de fermeture de connexion à partir des gestionnaires de demandes"
        default y
        help
            Si cet élément de configuration est défini,l'en-tête Connection: close sera défini dans les gestionnaires.
            Cela ferme la connexion HTTP et libère instantanément le serveur.

endmenu
```

## ESP32_hw2/Composants/WIFI_CONFIG/Kconfig.projbuild
```kconfig
# Kconfig
# 
# Le fichier Kconfig doit toujours être dans un composant
# Chaque composant peut également avoir un fichier Kconfig, à côté de CMakeLists.txt. Celui-ci contient les paramètres de configuration à ajouter au menu de configuration de ce composant.
# 
# Deux façons d'utiliser Kconfig :
# 	- dans un composant au niveau supérieur
# 	- s'il est utilisé dans un projet, il doit être dans myproject/main car nous savons que main est un composant spécial et que
# 		Kconfig ne peut être défini que dans un composant

menu "Configuration connection Wifi"

config SSID_POINT_ACCES
    string "SSID du point d'accès"
    default "esp32"
    help
        SSID (nom de réseau) diffusé par esp32.

config MOT_PASSE_POINT_ACCES
    string "mot de passe du point d'acces"
    default "serveuresp"
    help
        Mot de passe pour se connecter au réseau crée par esp32, si MOT_PASSE_POINT_ACCES
        est vide autorisation ouverte à tous.

config NOMBRE_TENTATIVE_CONNECTION
    int "nombre de tentative de connection de esp32 au réseau WIFI (2,4 Ghz)"
    default 3
    help
        Défini le nombre de tentative de connection au réseau wifi préalablement enregistré.
        Si impossible, re-enregistrer un nouveau réseau.

config CANAL_WIFI_AP
    int "Canal Wifi du Point d'Accès"
    default 1
    help
        Attention: le canal doit correspondre à la région, sinon le point d'accès ne sera pas visible.

config NBR_MAX_CONNECTIONS_AP
    int "Nombre maxi de connection au serveur en mode AP"
    default 2
    help
        Le nombre maxi est de 4.

config NOM_HOTE_MDNS
    string "Nom de l'hote mdns"
    default "esp32"
    help
        nom de l'hote mdns

config TACHE_ETAT_WIFI
    bool "Lance la tache etat_wifi"
    default y
    help
        Lance le task "etat_wifi" pour indiquer l'état de la connection wifi et modifier la configuration.

# config LED_CONNECTION
#     bool "Utiliser une led pour visualiser l'état de la connection wifi"
#     default y
#     depends on TACHE_ETAT_WIFI
#     help
#         Si la led clignote rapidement alors esp32 n'a pas pu se connecter au wifi. 
#         Se connecter au point d'acces de l'esp32 pour entrer SSID et mot de passe du wifi 
#         auquel connecter esp32 (2,4 Ghz)
# 
# config GPIO_LED_CON
#     int "GPIO à utiliser pour connecter la led"
#     default 14
#     depends on LED_CONNECTION
#     help
#         Choisir le GPIO à utiliser pour connecter la led.

config BOUTON_AP
    bool "Utiliser un bouton pour basculer en mode Point d'Accès 192.168.4.1"
    default y
    depends on TACHE_ETAT_WIFI
    help
        Utiliser un bouton pour basculer en mode Point d'Accès.
        Permet de se connecter à l'ESP32 avec l'adresse 192.168.4.1 pour configurer le wifi.
        Se connecter au point d'accès de l'esp32 pour entrer SSID et mot de passe du wifi 
        auquel connecter esp32 (2,4 Ghz)

config GPIO_BTN_AP
    int "GPIO pour bouton de démarrage AP, par défaut 0 = bouton boot"
    default 0
    depends on BOUTON_AP
    help
        Numéro du GPIO à utiliser pour connecter le bouton pour lancer le démarrage du serveur en Point d'Accès.
        Permet de configurer le Wifi et la mise à jour OTA.
        Appuyer sur le bouton dans les 10 secondes suivant le reset.

endmenu
```

## ESP32_hw2/main/Kconfig.projbuild
```kconfig
menu "Configuration Main"
      config CARTE_PERSO
      bool "Type de carte utilisée y = carte perso, n = carte support"
      default y
      help
        Pour définir les pins en fonction de la carte utilisée

    config LED_CONNECTION
        bool "Utiliser une led pour visualiser l'état de la connection wifi"
        default y
        help
            Si la led clignote rapidement alors esp32 n'a pas pu se connecter au wifi.   
            Se connecter au point d'acces de l'esp32 pour entrer SSID et mot de passe du wifi
            auquel connecter esp32 (2,4 Ghz).
            
            A NOTER : LED_CONNECTION est initialisée et utilisée par le module WIFI_CONFIG.

    config GPIO_LED_CON
        int "numéro GPIO à utiliser pour connecter la led info connection"
        depends on LED_CONNECTION
        default "23" if CARTE_PERSO
        default "14" if !CARTE_PERSO
        help
            Choisir le GPIO à utiliser pour connecter la led : 23 pour carte perso.

    config GPIO_LED2
        int "numéro GPIO à utiliser pour connecter la led2"
        depends on CARTE_PERSO
        default "22"
        help
            Choisir le GPIO à utiliser pour connecter la led2 : 22 pour carte perso.

    config BUS_SPI
    bool "Utiliser le bus SPI"
    default y
    help
        Permet de configure le bus SPI 

    if BUS_SPI
      choice HSPI_HOST
          prompt "Choix du bus SPI"
          default HSPI
          help
              Bus HSPI = SPI2, VSPI = SPI3.

          config HSPI
              bool "bus HSPI = SPI2"
          config VSPI
              bool "bus VSPI = SPI3"
      endchoice
    
      config GPIO_MOSI
          int "numéro GPIO signal MOSI"
          default "13" if CARTE_PERSO
          default "27" if !CARTE_PERSO
          help
              HSPID : MOSI = 13.

      config GPIO_MISO
          int "numéro GPIO signal MISO"
          default "12" if CARTE_PERSO
          default "33" if !CARTE_PERSO
         help
              HSPIQ = MISO = 12.

      config GPIO_SCLK
          int "numéro GPIO signal SCLK"
          default "14" if CARTE_PERSO
          default "26" if !CARTE_PERSO
          help
              HSPICLK = CLK = 14.

      config GPIO_CS
          int "numéro GPIO signal CS"
          default "15" if CARTE_PERSO
          default "25" if !CARTE_PERSO
          help
              HSPICS0 = CS0 = 15.
              
      config GPIO_IRQ_RFM12
          int "numéro GPIO entree interruption"
          default "27" if CARTE_PERSO
          default "32" if !CARTE_PERSO
          depends on BUS_SPI
          help
              GPIO entrée interruption cablee sur sortie IRQ du RFM12.
              "27" si CARTE_PERSO
              "32" si !CARTE_PERSO

    endif

    config BUS_ONE_WIRE
      bool "Créer un bus One Wire"
      default y
      help
          Permet de configurer un bus One Wire 

    if BUS_ONE_WIRE
      config GPIO_ONE_WIRE
          int "numéro GPIO one wire : 32 pour carte perso"
          default "32" if CARTE_PERSO
          default "2" if !CARTE_PERSO
          help
              numéro du GPIO pour données One Wire : 32 pour carte perso
      menu "Capteur One Wire"
        config ONE_WIRE_INTERNAL_PULLUP
            bool "Enable internal pull-up resistor"
            default n
            help
              Check this option if you don't have external pull-up resistor on data GPIO.   
              DHT sensors that come mounted on a PCB generally have pull-up resistors on the data pin.   
              But for stable operation, it is recommended to provide an external pull-up resistor.   
          
        choice CAPTEUR_ONE_WIRE
            prompt "Type de capteur"
            default TYPE_DS18B20
            config TYPE_DHT
                bool "USE_DHT"
            config TYPE_DS18B20
                bool "USE_DS18B20"
        endchoice

        choice TYPE_DHT
            prompt "Type de capteur"
            default TYPE_DHT11
            depends on TYPE_DHT
            config TYPE_DHT11
                bool "DHT11"
            config TYPE_AM2301
                bool "DHT21/DHT22/AM2301/AM2302/AM2321"
            config TYPE_SI7021
                bool "Itead Si7021"
        endchoice

        config CAPTEUR_DS18B20
            bool "utiliser un capteur DS18B20 ?"
            default y
            depends on TYPE_DS18B20
            help
                pour configurer et utiliser un capteur de type DS18B20
      endmenu
    endif

    config LED_RGB
        bool "utiliser des leds RGB"
        default y
        help
            Utiliser les fonctions PWM de la bibliothèque ledc

    if LED_RGB
      config GPIO_LED_R
          int "GPIO led Red"
          default "33"

      config GPIO_LED_G
          int "GPIO led Green"
          default "25"

      config GPIO_LED_B
          int "GPIO led Blue"
          default "26"
    endif

    config Homekit
        bool "Utiliser HomeKit"
        default y

    if Homekit
      menu "Configuration code HomeKit"

          config USE_HARDCODED_SETUP_CODE
              bool "Use hard-coded setup code"
              default y
              help
                  HomeKit does not recommend having the setup code programmed in the accessory as is.
                  Instead, it expects setup info (salt-verifier pair) generated for the given setup code.
                  Use this option only for testing purposes. For production, the setup info should be
                  used.

          config SETUP_CODE
              string "HomeKit Setup Code"
              default "111-22-333"
              depends on USE_HARDCODED_SETUP_CODE
              help
                  Setup code to be used for HomeKot pairing, if hard-coded setup code is enabled.

          config SETUP_ID
              string "HomeKit Setup Id"
              default "ES32"
              depends on USE_HARDCODED_SETUP_CODE
              help
                  Setup id to be used for HomeKot pairing, if hard-coded setup code is enabled.

      endmenu
    endif
endmenu
```

## ESP32_hw2/main/device/RFM12/Kconfig.projbuild
```kconfig
menu "Configuration RFM 12"
    depends on BUS_SPI
    
    config TYPE_RFM12
        bool "y = RFM12 type B"
        default n

    choice FREQ_RFM12
        prompt "fréquence centrale RFM12"
        default F_RFM_868
        help
            Choix de la fréquence centrale du module RFM12.
        config F_RFM_433
            bool "RFM_433"
        config F_RFM_868
            bool "RFM_868"
        config F_RFM_915
            bool "RFM_915"
    endchoice

endmenu
```
